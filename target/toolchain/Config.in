## target/toolchain/Config.in
```kconfig
config MAKE_TOOLCHAIN
	bool "Package the OpenWrt-based Toolchain"
	default BUILDBOT
	help
	  Package the LLVM toolchain as a tarball under the bin/ directory.
```

## toolchain/Config.in
```kconfig
# Copyright (C) 2006-2013 OpenWrt.org
#
# This is free software, licensed under the GNU General Public License v2.
# See /LICENSE for more information.
#

config USE_LLVM_TOOLCHAIN
	bool
	default y if USE_MUSL
	select USE_LLVM_HOST
	select PACKAGE_libatomic

menuconfig TARGET_OPTIONS
	bool "Target Options"  if DEVEL

	config TARGET_OPTIMIZATION
		string "Target Optimizations" if TARGET_OPTIONS
		default DEFAULT_TARGET_OPTIMIZATION
		help
		  Optimizations to use when building for the target host.

	config SOFT_FLOAT
		bool "Use software floating point by default" if TARGET_OPTIONS
		default y if !HAS_FPU
		depends on arm || armeb || powerpc || mipsel || mips || mips64el || mips64
		help
		  If your target CPU does not have a Floating Point Unit (FPU) or a
		  kernel FPU emulator, but you still wish to support floating point
		  functions, then everything will need to be compiled with soft floating
		  point support (-msoft-float).

		  Most people will answer N.

	config USE_MIPS16
		bool "Build packages with MIPS16 instructions" if TARGET_OPTIONS
		depends on HAS_MIPS16
		default y
		help
		  If your target CPU does support the MIPS16 instruction set
		  and you want to use it for packages, enable this option.
		  MIPS16 produces smaller binaries thus reducing pressure on
		  caches and TLB.

		  Most people will answer N.


	config BPF_TOOLCHAIN_HOST
		bool
		default y
		select USE_LLVM_HOST

config NEED_TOOLCHAIN
	bool
	default y

menuconfig TOOLCHAINOPTS
	bool "Toolchain Options"  if DEVEL
	depends on NEED_TOOLCHAIN

menuconfig EXTRA_TARGET_ARCH
	bool
	prompt "Enable an extra toolchain target architecture" if TOOLCHAINOPTS
	help
	  Some builds may require a 'biarch' toolchain. This option
	  allows you to specify an additional target arch.

	  Most people will answer N here.

	config EXTRA_TARGET_ARCH_NAME
		string
		prompt "Extra architecture name" if EXTRA_TARGET_ARCH
		help
		  Specify the cpu name (eg powerpc64 or x86_64) of the
		  additional target architecture.

	config EXTRA_TARGET_ARCH_OPTS
		string
		prompt "Extra architecture compiler options" if EXTRA_TARGET_ARCH
		help
		  If you're specifying an addition target architecture,
		  you'll probably need to also provide options to make
		  the compiler use this alternate arch.

		  For example, if you're building a compiler that can build
		  both powerpc and powerpc64 binaries, you'll need to
		  specify -m64 here.


	choice
		prompt "MIPS64 user-land ABI" if TOOLCHAINOPTS && (mips64 || mips64el)
		default MIPS64_ABI_N64
		help
		   MIPS64 supports 3 different user-land ABIs: o32 (legacy),
		   n32 and n64.

		config MIPS64_ABI_N64
			bool "n64"

		config MIPS64_ABI_N32
			depends on !LIBC_USE_MUSL
			bool "n32"

		config MIPS64_ABI_O32
			bool "o32"

	endchoice

config DWARVES
	bool
	prompt "Build pahole" if TOOLCHAINOPTS
	depends on !HOST_OS_MACOS
	help
	  Enable if you want to build pahole and the dwarves tools.

config NASM
	bool
	depends on ( i386 || x86_64 )
	prompt "Build nasm" if TOOLCHAINOPTS
	default y
	help
	  Enable if you want to build nasm

comment "C Library"
	depends on TOOLCHAINOPTS

config LIBC_USE_MUSL
	bool
	default y
	select USE_MUSL

config LIBC_USE_GLIBC
	bool

source "toolchain/musl/Config.in"

config HAS_BPF_TOOLCHAIN
	default y
	bool

config NEED_BPF_TOOLCHAIN
	bool

config USE_LLVM_HOST
	bool

config USE_GLIBC
	bool

config USE_MUSL
	default y
	bool

config SSP_SUPPORT
	default y if !PKG_CC_STACKPROTECTOR_NONE
	bool

config LIBC
	string
	default "glibc"   if USE_GLIBC
	default "musl"	  if USE_MUSL

config TARGET_SUFFIX
	string
	default "gnueabi"         if USE_GLIBC && (arm || armeb)
	default "gnu"             if USE_GLIBC && !(arm || armeb)
	default "muslgnueabi"     if USE_MUSL && (arm || armeb)
	default "musl"            if USE_MUSL && !(arm || armeb)

config MIPS64_ABI
	depends on mips64 || mips64el
	string
	default "64" if MIPS64_ABI_N64
	default "n32" if MIPS64_ABI_N32
	default "32" if MIPS64_ABI_O32
	default "64"
```
